// SPDX-License-Identifier: GPL-2.0
/*
 * Space Cubics SC-OBC Module V1
 * Copyright (C) 2026 Space Cubics Inc.
 */

#include "versal-scobc-v1-reva.dtsi"

/ {
	model = "Space Cubics SC-OBC Module V1 Developer Grade Rev.A";
	compatible = "sc,scobc-v1-devgrade-reva", "sc,scobc-v1", "xlnx,versal";
};
